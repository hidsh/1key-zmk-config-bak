/* boards/shields/1key/1key.overlay */
/ {
    chosen {
        zmk,kscan = &kscan0;
    };

    kscan0: kscan_0 {
        compatible = "zmk,kscan-gpio-direct";
        input-gpios
            = <&xiao_d 10 (GPIO_ACTIVE_LOW | GPIO_PULL_UP)>
            ;
    };
};
